## Kconfig
```kconfig
source "techpack/xiaomi-msm8953/touchscreen/Kconfig"
source "techpack/xiaomi-msm8953/leds/Kconfig"
source "techpack/xiaomi-msm8953/power_supply/Kconfig"
source "techpack/xiaomi-msm8953/vibrator/Kconfig"
```

## leds/Kconfig
```kconfig
config LEDS_AW2023
	tristate "LED support for AW2023"
	depends on LEDS_CLASS && I2C
	help
	  This option enables support for the AW2023 RGB LED connected
	  through I2C. Say Y to enable support for the AW2013 LED.
```

## power_supply/qcom/Kconfig
```kconfig
config QPNP_SMBCHARGER
	tristate "QPNP SMB Charger driver"
	depends on MFD_SPMI_PMIC
	help
	  Say Y here to enable the dual path switch mode battery charger which
	  supports USB detection and battery charging up to 3A.
	  The driver also offers relevant information to userspace via the
	  power supply framework.
```

## touchscreen/Kconfig
```kconfig
config TOUCHSCREEN_SYSCTL_MI8953
 	bool "Sysctl control interface for Xiaomi MSM8953 touchscreens"
 	help
 	  Say Y here to enable sysctl control interface for Xiaomi MSM8953 touchscreens

source "techpack/xiaomi-msm8953/touchscreen/focaltech_touch/Kconfig"
```

## vibrator/Kconfig
```kconfig
config INPUT_QTI_HAPTICS_MI8953
 	tristate "Haptics support for QTI PMIC"
 	depends on MFD_SPMI_PMIC
 	help
 	  This option enables device driver support for the haptics peripheral
 	  found on Qualcomm Technologies, Inc. PMICs.  The haptics peripheral
 	  is capable of driving both LRA and ERM vibrators.  This module provides
 	  haptic feedback for user actions such as a long press on the touch screen.
```
